## examples/example_ssh_server/main/Kconfig.projbuild
```kconfig
menu "Example Configuration"

    config CONSOLE_STORE_HISTORY
        bool "Store command history in flash"
        default y
        help
            Linenoise line editing library provides functions to save and load
            command history. If this option is enabled, initializes a FAT filesystem
            and uses it to store command history.

    config EXAMPLE_DEFAULT_PORT
        string "SSH server port"
        default "22"
        help
            TCP port the SSH server binds to.

    config EXAMPLE_DEBUG_LEVEL
        string "Log verbosity (1-4)"
        default "1"
        help
            libssh log verbosity level as a string. Increase for more verbose logs.

    config EXAMPLE_ALLOW_PASSWORD_AUTH
        bool "Enable password authentication"
        default n
        help
            Allow SSH password authentication.

    config EXAMPLE_ALLOW_PUBLICKEY_AUTH
        bool "Enable public-key authentication"
        default y
        help
            Allow SSH public-key authentication.

    config EXAMPLE_DEFAULT_USERNAME
        string "Default username"
        default "user"
        help
            Username required by the example server.

    config EXAMPLE_DEFAULT_PASSWORD
        string "Default password"
        depends on EXAMPLE_ALLOW_PASSWORD_AUTH
        default "password"
        help
            Password for the default user (only used if password auth is enabled).

endmenu
```
